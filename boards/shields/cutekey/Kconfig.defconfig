## boards/shields/cutekey/Kconfig.defconfig
```kconfig
    # Copyright (c) 2022 The ZMK Contributors
# SPDX-License-Identifier: MIT

if SHIELD_CUTEKEY

config ZMK_KEYBOARD_NAME
    default "cutekey"

endif # SHIELD_CUTEKEY
```
